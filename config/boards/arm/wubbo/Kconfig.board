## config/boards/arm/wubbo/Kconfig.board
```kconfig
# Wubbo board configuration

# Copyright (c) 2022 The ZMK Contributors
# SPDX-License-Identifier: MIT

config BOARD_WUBBO
	bool "wubbo"
	depends on SOC_NRF52840_QIAA

config BOARD_WUBBO_RIGHT
	bool "wubbo right"
	depends on SOC_NRF52840_QIAA

config BOARD_WUBBO_LEFT
	bool "wubbo left"
	depends on SOC_NRF52840_QIAA

config BOARD_WUBBO_RESET
	bool "wubbo reset"
	depends on SOC_NRF52840_QIAA
```

## config/boards/arm/wubbo/Kconfig.defconfig
```kconfig
# Copyright (c) 2022 The ZMK Contributors
# SPDX-License-Identifier: MIT
 
if BOARD_WUBBO_LEFT

config ZMK_SPLIT_BLE_ROLE_CENTRAL
	default y

endif

config ZMK_SPLIT
	default y

config ZMK_KEYBOARD_NAME
	default "Wubbo"

if USB

config USB_NRFX
	default y

config USB_DEVICE_STACK
	default y

endif # USB

config BT_CTLR
	default BT

config ZMK_BLE
	default y

config ZMK_USB
	default y
```

## config/boards/shields/mable/Kconfig.defconfig
```kconfig
# Copyright (c) 2022 ZMK Contributors
# SPDX-License-Identifier: MIT

if SHIELD_MABLE_DONGLE

config ZMK_KEYBOARD_NAME
    default "mable"

config ZMK_SPLIT_ROLE_CENTRAL
    default y

config ZMK_USB
    default y

endif
 
if SHIELD_MABLE_LEFT

config ZMK_KEYBOARD_NAME
	default "mable left"

endif

if SHIELD_MABLE_RIGHT

config ZMK_KEYBOARD_NAME
	default "mable right"

endif

if SHIELD_MABLE_LEFT || SHIELD_MABLE_RIGHT || SHIELD_MABLE_DONGLE

config ZMK_SPLIT
	default y

config ZMK_BLE
    default y
	
endif
```

## config/boards/shields/mable/Kconfig.shield
```kconfig
# Copyright (c) 2020 The ZMK Contributors
# SPDX-License-Identifier: MIT

config SHIELD_MABLE_LEFT
    def_bool $(shields_list_contains,mable_left)

config SHIELD_MABLE_RIGHT
    def_bool $(shields_list_contains,mable_right)
```

## config/boards/shields/pica40/Kconfig.defconfig
```kconfig
# Copyright (c) 2020 The ZMK Contributors
# SPDX-License-Identifier: MIT

if SHIELD_PICA40_LEFT

config ZMK_KEYBOARD_NAME
	default "pica40"

config ZMK_SPLIT_ROLE_CENTRAL
	default y

endif

if SHIELD_PICA40_LEFT || SHIELD_PICA40_RIGHT

config ZMK_SPLIT
	default y

endif
```

## config/boards/shields/pica40/Kconfig.shield
```kconfig
# Copyright (c) 2020 The ZMK Contributors
# SPDX-License-Identifier: MIT

config SHIELD_PICA40_LEFT
    def_bool $(shields_list_contains,pica40_left)

config SHIELD_PICA40_RIGHT
    def_bool $(shields_list_contains,pica40_right)
```

## config/west.yml
```yaml
manifest:
  remotes:
    - name: zmkfirmware
      url-base: https://github.com/zmkfirmware
    - name: caksoylar  # zmk-rgbled-widget
      url-base: https://github.com/caksoylar
    - name: urob
      url-base: https://github.com/urob
    - name: eswai
      url-base: https://github.com/eswai
    - name: prospector
      url-base: https://github.com/t-ogura
  projects:
    - name: zmk
      remote: zmkfirmware
      revision: main
      import: app/west.yml
    - name: zmk-rgbled-widget
      remote: caksoylar
      revision: main
    - name: zmk-helpers
      remote: urob
      revision: main
    - name: zmk-naginata
      remote: eswai
      revision: main
    - name: prospector-zmk-module
      remote: prospector
      revision: v1.0.0
      path: modules/prospector-zmk-module
  self:
    path: config
```
